## application/edge_agent/boards/community/esp32_s3_st7735s/sdkconfig.defaults.board
```kconfig
# ST7735S Display Configuration for ESP32-S3
CONFIG_ESP_LCD_PANEL_ST7789=y
CONFIG_SPI_MASTER_ISR_IN_IRAM=y
CONFIG_ESP_DEFAULT_CPU_FREQ_MHZ_240=y
CONFIG_ESPTOOLPY_FLASHMODE_QIO=y
CONFIG_ESPTOOLPY_FLASHFREQ_80M=y
CONFIG_ESPTOOLPY_FLASHSIZE_8MB=y
CONFIG_PARTITION_TABLE_CUSTOM=y
CONFIG_PARTITION_TABLE_CUSTOM_FILENAME="partitions_8MB.csv"
CONFIG_SPIRAM=y
CONFIG_SPIRAM_MODE_OCT=y
CONFIG_SPIRAM_SPEED_80M=y
```

## application/edge_agent/boards/espressif/cyberz/sdkconfig.defaults.board
```kconfig
CONFIG_ESP_DEFAULT_CPU_FREQ_MHZ_240=y
CONFIG_ESPTOOLPY_FLASHMODE_QIO=y
CONFIG_ESPTOOLPY_FLASHFREQ_80M=y
CONFIG_ESPTOOLPY_FLASHSIZE_8MB=y
CONFIG_SPIRAM=y
CONFIG_SPIRAM_MODE_OCT=y
CONFIG_SPIRAM_SPEED_80M=y

CONFIG_ESP_BOARD_PERIPH_I2S_SUPPORT=y
CONFIG_ESP_BOARD_PERIPH_I2C_SUPPORT=y
CONFIG_ESP_BOARD_PERIPH_SPI_SUPPORT=y
CONFIG_ESP_BOARD_PERIPH_UART_SUPPORT=y
CONFIG_ESP_BOARD_PERIPH_RMT_SUPPORT=y

CONFIG_APP_CLAW_LUA_MODULE_ENVIRONMENTAL_SENSOR=y
CONFIG_LUA_MODULE_ENVIRONMENTAL_SENSOR_BACKEND_BME690=n
CONFIG_LUA_MODULE_ENVIRONMENTAL_SENSOR_BACKEND_DHT=y
```

## application/lcd_test/sdkconfig.defaults
```kconfig
# Minimal ST7789 test app
CONFIG_ESP_DEFAULT_CPU_FREQ_MHZ_240=y
CONFIG_ESPTOOLPY_FLASHMODE_QIO=y
CONFIG_ESPTOOLPY_FLASHFREQ_80M=y
CONFIG_ESPTOOLPY_FLASHSIZE_8MB=y
CONFIG_SPIRAM=y
CONFIG_SPIRAM_MODE_OCT=y
CONFIG_SPIRAM_SPEED_80M=y
CONFIG_ESP_CONSOLE_UART_TX_GPIO=43
CONFIG_ESP_CONSOLE_UART_RX_GPIO=44
CONFIG_PARTITION_TABLE_SINGLE_APP=y
```
